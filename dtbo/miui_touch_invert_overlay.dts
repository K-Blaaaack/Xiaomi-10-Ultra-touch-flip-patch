/dts-v1/;
/plugin/;

/ {
    fragment@0 {
        target = <&fts>;  /* FocalTech 节点 */
        __overlay__ {
            /* 反转 Y 轴 */
            touch-invert-y = <1>;
            /* 备用：FocalTech 可能需要的属性 */
            touch-y-reverse = <1>;
            touch-swap-xy = <0>;  /* 不交换 X/Y */
            /* 坐标范围（1080x2400） */
            touch-x-min = <0>;
            touch-x-max = <1080>;
            touch-y-min = <0>;
            touch-y-max = <2400>;
            /* FocalTech 兼容性 */
            compatible = "focaltech,fts";
        };
    };
};