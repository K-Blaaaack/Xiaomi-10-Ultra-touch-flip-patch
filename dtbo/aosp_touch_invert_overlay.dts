/dts-v1/;
/plugin/;

/ {
    fragment@0 {
        target = <&fts>;
        __overlay__ {
            /* 反转 Y 轴 */
            touch-invert-y = <1>;
            touch-y-reverse = <1>;
            touch-swap-xy = <0>;
            /* 坐标范围 */
            touch-x-min = <0>;
            touch-x-max = <1080>;
            touch-y-min = <0>;
            touch-y-max = <2400>;
            /* FocalTech 兼容性 */
            compatible = "focaltech,fts";
            /* AOSP 特定参数 */
            touch-pressure-scale = <0x66>;  /* 示例值，视驱动调整 */
        };
    };
};